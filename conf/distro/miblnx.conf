## conf/distro/miblnx.conf
```bitbake
DISTRO = "miblnx"
DISTRO_NAME = "MIS REF DISTRO"
DISTRO_VERSION = "5.0.3"
DISTRO_CODENAME = "scarthgap"
SDK_VENDOR = "-miblnxsdk"
SDK_VERSION = "${@d.getVar('DISTRO_VERSION').replace('snapshot-${METADATA_REVISION}', 'snapshot')}"
SDK_VERSION[vardepvalue] = "${SDK_VERSION}"

MAINTAINER = "Maintainers <rwoerle@mibtec.de>"

INCOMPATIBLE_LICENSE = "AGPL-3.0*"

TARGET_VENDOR = "-miblnx"
LOCALCONF_VERSION = "2"

# Override these in poky based distros
MIBLNX_DEFAULT_DISTRO_FEATURES = "opengl ptest multiarch wayland vulkan"
MIBLNX_DEFAULT_EXTRA_RDEPENDS = "packagegroup-core-boot"
MIBLNX_DEFAULT_EXTRA_RRECOMMENDS = "kernel-module-af-packet"

DISTRO_FEATURES ?= "${DISTRO_FEATURES_DEFAULT} ${MIBLNX_DEFAULT_DISTRO_FEATURES}"
DISTROOVERRIDES = "miblnx"

PREFERRED_VERSION_linux-yocto ?= "6.6%"
PREFERRED_VERSION_linux-yocto-rt ?= "6.6%"

SDK_NAME = "${DISTRO}-${TCLIBC}-${SDKMACHINE}-${IMAGE_BASENAME}-${TUNE_PKGARCH}-${MACHINE}"
SDKPATHINSTALL = "/opt/${DISTRO}/${SDK_VERSION}"

DISTRO_EXTRA_RDEPENDS += "${MIBLNX_DEFAULT_EXTRA_RDEPENDS}"
DISTRO_EXTRA_RRECOMMENDS += "${MIBLNXDEFAULT_EXTRA_RRECOMMENDS}"

TCLIBCAPPEND = ""

PACKAGE_CLASSES ?= "package_rpm"

SANITY_TESTED_DISTROS ?= " \
            poky-4.3 \n \
            poky-5.0 \n \
            ubuntu-20.04 \n \
            ubuntu-22.04 \n \
            ubuntu-23.04 \n \
            fedora-38 \n \
            fedora-39 \n \
            centosstream-8 \n \
            debian-11 \n \
            debian-12 \n \
            opensuseleap-15.4 \n \
            almalinux-8.8 \n \
            almalinux-9.2 \n \
            rocky-9 \n \
            linuxmint-21.3 \n \
            "

require conf/distro/include/no-static-libs.inc
require conf/distro/include/yocto-uninative.inc
require conf/distro/include/security_flags.inc
INHERIT += "uninative"

BB_SIGNATURE_HANDLER ?= "OEEquivHash"
BB_HASHSERVE ??= "auto"

MIBLNX_INIT_MANAGER = "sysvinit"
INIT_MANAGER ?= "${MIBLNX_INIT_MANAGER}"

# We need debug symbols so that SPDX license manifests for the kernel work
KERNEL_EXTRA_FEATURES:append = " features/debug/debug-kernel.scc"

# Enable creation of SPDX manifests by default
INHERIT += "create-spdx"
```
